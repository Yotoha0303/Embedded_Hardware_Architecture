## templates/esp32s3_starter/sdkconfig.defaults
```kconfig
# ESP32-S3 基础硬件默认编译配置
CONFIG_IDF_TARGET="esp32s3"

# Flash 存储配置 (8MB Quad SPI, 80MHz)
CONFIG_ESPTOOLPY_FLASHSIZE_8MB=y
CONFIG_ESPTOOLPY_FLASHMODE_DIO=y
CONFIG_ESPTOOLPY_FLASHFREQ_80M=y
CONFIG_ESPTOOLPY_AFTER_RESET=y

# FreeRTOS 调度器频率 (1000Hz / 1ms 滴答)
CONFIG_FREERTOS_HZ=1000

# 控制台输出配置 (优先 Native USB CDC，免外置串口芯片)
# 若使用原生 USB 口烧录及监听，请开启此项：
CONFIG_ESP_CONSOLE_USB_SERIAL_JTAG=y

# 日志输出等级 (INFO 级别)
CONFIG_LOG_DEFAULT_LEVEL_INFO=y
CONFIG_LOG_MAXIMUM_LEVEL_VERBOSE=y
```
